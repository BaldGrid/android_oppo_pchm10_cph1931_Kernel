
/dts-v1/;
 
/ {
     qcom,rtic-id = <1>;
     MP_DATA = [
        00 00 a0 09 80 ff ff ff 00 00 98 01 00 00 00 00 c8 04 00 00 61 3f 0a d9 78 72 da a6 31 f1 c7 15 53 51 14 a4 9a 48 ec 46 01 e8 f3 87 94 29 85 2d b4 6f 1d 31
    ];
};
 